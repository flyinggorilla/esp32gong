## main/Kconfig.projbuild
```kconfig
menu "Wifi Configuration"

config WIFI_SSID
    string "WiFi SSID"
	help
		SSID (network name) to connect to.

config WIFI_PASSWORD
    string "WiFi Password"
	help
		WiFi password (WPA or WPA2) to use.

endmenu
```
